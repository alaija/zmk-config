## config/boards/shields/tbk/Kconfig.defconfig
```kconfig
if SHIELD_TBK_LEFT

config ZMK_KEYBOARD_NAME
    default "TBK Pride"

config ZMK_SPLIT_ROLE_CENTRAL
    default y

endif

if SHIELD_TBK_RIGHT

config ZMK_KEYBOARD_NAME
	default "TBK Pride"
endif

if SHIELD_TBK_LEFT || SHIELD_TBK_RIGHT

config ZMK_SPLIT
    default y

config BT_CTLR
	default BT

config ZMK_BLE
	default y

endif
```
